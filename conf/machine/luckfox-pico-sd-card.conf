## conf/machine/luckfox-pico-sd-card.conf
```bitbake
#@TYPE: Machine
#@NAME: Luckfox Pico (SD card)
require conf/machine/include/luckfox-pico.inc
require conf/machine/include/luckfox-sd-card.inc
```

## conf/machine/luckfox-pico-spi-nand.conf
```bitbake
#@TYPE: Machine
#@NAME: Luckfox Pico (SPI NAND)
require conf/machine/include/luckfox-pico.inc
require conf/machine/include/luckfox-spi-nand.inc
```

## recipes-kernel/linux/linux-yocto-dev/rkcif-vendor/Kconfig
```kconfig
# SPDX-License-Identifier: GPL-2.0-only

config VIDEO_ROCKCHIP_CIF_VENDOR
	tristate "Rockchip Camera Interface driver (vendor stack)"
	depends on VIDEO_DEV
	depends on ARCH_ROCKCHIP || COMPILE_TEST
	depends on V4L_PLATFORM_DRIVERS
	depends on PM && COMMON_CLK
	select MEDIA_CONTROLLER
	select VIDEOBUF2_DMA_CONTIG
	select VIDEOBUF2_DMA_SG
	select VIDEOBUF2_VMALLOC
	select V4L2_FWNODE
	select VIDEO_V4L2_SUBDEV_API
	select VIDEO_ROCKCHIP_CSI2_DPHY
	default n
	help
	  Rockchip vendor camera stack for RV1103/RV1106, forward-ported from
	  the 5.10 BSP kernel. It provides the CIF capture device plus the MIPI
	  CSI2 receiver, and coexists with the mainline rkcif driver because the
	  device tree compatibles differ (rockchip,*-cif and rockchip,rkcif-dvp
	  versus rockchip,px30-vip and rockchip,rk3568-vicap).

	  To compile this driver as a module, choose M here: the module will be
	  called rockchip-cif-vendor.
```
