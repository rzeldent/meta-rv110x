## conf/machine/include/rv-ubifs.inc
```bitbake
# 'RV_SPI_NAND_STORAGE' indicates the user wants to use the
# ubifs configuration from this layer
OVERRIDES .= "${@ ':rv-ubifs' if bb.utils.to_boolean(d.getVar('RV_SPI_NAND_STORAGE'), False) else ''}"

UBOOT_CONFIG:rv-ubifs = "spi-nand"

UBI_VOLNAME = "rootfs"

UBOOT_EXTLINUX_ROOT:rv-ubifs = "ubi.mtd=rootfs root=ubi0:${UBI_VOLNAME}"
UBOOT_EXTLINUX_KERNEL_ARGS:rv-ubifs = "rootfstype=ubifs rootwait rw ${mtdparts}"

IMAGE_FSTYPES:remove:rv-ubifs = "wic${WIC_COMPRESSION_EXTENSION} wic.bmap"

MKUBIFS_ARGS = "-F -m 2048 -e 124KiB -c 1020"
UBINIZE_ARGS = "-m 2048 -p 128KiB -O 2048"
```

## conf/machine/luckfox-pico-max-sd-card.conf
```bitbake
#@TYPE: Machine
#@NAME: Luckfox Pico-max (SD card)
require conf/machine/include/luckfox-pico-max.inc
require conf/machine/include/luckfox-sd-card.inc
```

## conf/machine/luckfox-pico-max-spi-nand.conf
```bitbake
#@TYPE: Machine
#@NAME: Luckfox Pico-max (SPI NAND)
require conf/machine/include/luckfox-pico-max.inc
require conf/machine/include/luckfox-spi-nand.inc
```

## conf/machine/luckfox-pico-mini-sd-card.conf
```bitbake
#@TYPE: Machine
#@NAME: Luckfox Pico-mini (SD card)
require conf/machine/include/luckfox-pico-mini.inc
require conf/machine/include/luckfox-sd-card.inc
```

## conf/machine/luckfox-pico-mini-spi-nand.conf
```bitbake
#@TYPE: Machine
#@NAME: Luckfox Pico-mini (SPI NAND)
require conf/machine/include/luckfox-pico-mini.inc
require conf/machine/include/luckfox-spi-nand.inc
```

## conf/machine/luckfox-pico-pi-sd-card.conf
```bitbake
#@TYPE: Machine
#@NAME: Luckfox Pico-pi (SD card)
require conf/machine/include/luckfox-pico-pi.inc
require conf/machine/include/luckfox-sd-card.inc
```

## conf/machine/luckfox-pico-pi-spi-nand.conf
```bitbake
#@TYPE: Machine
#@NAME: Luckfox Pico-pi (SPI NAND)
require conf/machine/include/luckfox-pico-pi.inc
require conf/machine/include/luckfox-spi-nand.inc
```

## conf/machine/luckfox-pico-plus-sd-card.conf
```bitbake
#@TYPE: Machine
#@NAME: Luckfox Pico-plus (SD card)
require conf/machine/include/luckfox-pico-plus.inc
require conf/machine/include/luckfox-sd-card.inc
```

## conf/machine/luckfox-pico-plus-spi-nand.conf
```bitbake
#@TYPE: Machine
#@NAME: Luckfox Pico-plus (SPI NAND)
require conf/machine/include/luckfox-pico-plus.inc
require conf/machine/include/luckfox-spi-nand.inc
```
