/* Removable SD card slot when SDIO WiFi is not selected. */
&sdmmc {
	max-frequency = <50000000>;
	no-sdio;
	no-mmc;
	supports-sd;
	bus-width = <4>;
	cap-sd-highspeed;
	disable-wp;
	pinctrl-names = "default";
	pinctrl-0 = <&sdmmc0_clk &sdmmc0_cmd &sdmmc0_bus4 &sdmmc0_det>;
	status = "okay";
};
